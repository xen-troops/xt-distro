## meta/conf/layer.conf
```bitbake
# We have a conf and classes directory, add to BBPATH
BBPATH =. "${LAYERDIR}:"

# We have recipes-* directories, add to BBFILES
BBFILES += "${LAYERDIR}/recipes-*/*/*.bb \
            ${LAYERDIR}/recipes-*/*/*.bbappend"

BBFILE_COLLECTIONS += "xt-core"
BBFILE_PATTERN_xt-core = "^${LAYERDIR}/"
BBFILE_PRIORITY_xt-core = "5"
```

## meta/conf/machine/h3ulcb-4x2g.conf
```bitbake
require xt-distro-machine.inc

MACHINEOVERRIDES =. "rcar:rcar-gen3:r8a7795-es3:"
```

## meta/conf/machine/imx8qmolu-b3.conf
```bitbake
require xt-distro-machine.inc

MACHINEOVERRIDES =. "mx8:mx8qm:olu:olu-b0:imx8qmolu-b3:"
```

## meta/conf/machine/salvator-xs-m3-2x4g.conf
```bitbake
require xt-distro-machine.inc

MACHINEOVERRIDES =. "rcar:rcar-gen3:r8a7796-es3:"
```

## meta/conf/machine/xt-distro-machine.inc
```bitbake
#@TYPE: Machine
#@NAME: common_pc
#@DESCRIPTION: Machine configuration for running a common x86

DEFAULTTUNE ?= "x86-64"
require conf/machine/include/tune-core2.inc

MACHINE_FEATURES += "x86"
```
